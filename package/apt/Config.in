## package/apt/Config.in
```kconfig
config BR2_PACKAGE_APT
	bool "apt"
	select BR2_PACKAGE_APT
	select BR2_PACKAGE_OPENSSL
	select BR2_PACKAGE_BERKELEYDB
	select BR2_PACKAGE_ZLIB
	select BR2_PACKAGE_XZ
	select BR2_PACKAGE_BZIP2
	select BR2_PACKAGE_LZ4
	select BR2_PACKAGE_XXHASH
	select BR2_PACKAGE_HOST_TRIEHASH
	help
	  The APT package management tool
```

## package/dpkg/Config.in
```kconfig
config BR2_PACKAGE_DPKG
	bool "dpkg"
	select BR2_PACKAGE_LIBMD
	select BR2_PACKAGE_TAR
	help
	  The Debian Package Manager
```

## package/nextvi/Config.in
```kconfig
config BR2_PACKAGE_NEXTVI
	bool "nextvi"
	help
	  Next version of neatvi (a small vi/ex editor) for editing bidirectional UTF-8 text
```

## package/opendoas/Config.in
```kconfig
config BR2_PACKAGE_OPENDOAS
	bool "opendoas"
	select BR2_PACKAGE_HAS_OPENDOAS
	help
	  OpenDoas - A portable fork of the OpenBSD `doas` command

	  https://github.com/Duncaen/OpenDoas
```

## package/tinyx/Config.in
```kconfig
config BR2_PACKAGE_TINYX
	bool "tinyx"
	select BR2_PACKAGE_HAS_TINYX
	help
	  Smallest X11 server binary
```

## package/triehash/Config.in.host
```kconfig
config BR2_PACKAGE_HOST_TRIEHASH
	bool "host triehash"
	help
	  Generator for order-preserving minimal perfect hash functions in C
```
